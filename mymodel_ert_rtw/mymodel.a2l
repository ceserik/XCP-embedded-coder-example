/******************************************************************************
* ASAP2 file: mymodel.a2l
* Academic License - for use in teaching, academic research, and meeting
* course requirements at degree granting institutions only. Not for
* government, commercial, or other organizational use.
* Code generation for model "mymodel".
* Model version : 1.11
* Simulink Coder version : 23.2 (R2023b) 01-Aug-2023
* C source code generated on : Wed Apr 08 08:58:23 2026
* Target selection: ert.tlc
* Embedded hardware selection: Intel->x86-64 (Windows64)
* Code generation objectives: Unspecified
* Validation result: Not run
* (add additional file header information here)
******************************************************************************/ ASAP2_VERSION 1 71
/* Version 1.71 */
/begin PROJECT ProjectName "Project Comment Goes Here"
/begin HEADER "Header Comments go here" /end HEADER
/begin MODULE ModuleName "Module Comment Goes Here"
/begin IF_DATA XCP
 /begin PROTOCOL_LAYER 0x0100 0x03E8 0x00C8 0x0000 0x0000 0x0000 0x0000 0x0000 0xFF 0xFFFC BYTE_ORDER_MSB_LAST ADDRESS_GRANULARITY_BYTE OPTIONAL_CMD ALLOC_ODT_ENTRY OPTIONAL_CMD ALLOC_ODT OPTIONAL_CMD ALLOC_DAQ OPTIONAL_CMD FREE_DAQ OPTIONAL_CMD GET_DAQ_RESOLUTION_INFO OPTIONAL_CMD GET_DAQ_PROCESSOR_INFO OPTIONAL_CMD START_STOP_SYNCH OPTIONAL_CMD START_STOP_DAQ_LIST OPTIONAL_CMD SET_DAQ_LIST_MODE OPTIONAL_CMD WRITE_DAQ OPTIONAL_CMD SET_DAQ_PTR OPTIONAL_CMD SHORT_DOWNLOAD OPTIONAL_CMD DOWNLOAD OPTIONAL_CMD SHORT_UPLOAD OPTIONAL_CMD UPLOAD OPTIONAL_CMD SET_MTA /end PROTOCOL_LAYER
 /begin DAQ DYNAMIC 0xFFFF 0x0080 0x00 OPTIMISATION_TYPE_DEFAULT ADDRESS_EXTENSION_FREE IDENTIFICATION_FIELD_TYPE_ABSOLUTE GRANULARITY_ODT_ENTRY_SIZE_DAQ_BYTE 0xFF NO_OVERLOAD_INDICATION /begin TIMESTAMP_SUPPORTED 0x0001 SIZE_DWORD UNIT_1US /end TIMESTAMP_SUPPORTED /begin EVENT "10 ms" "10 ms" 0x0000 DAQ 0xFF 0x01 0x07 0x00 /end EVENT /end DAQ
 /begin XCP_ON_TCP_IP 0x0100 0x453D HOST_NAME "localhost" /end XCP_ON_TCP_IP
/end IF_DATA
/begin MOD_PAR "MOD PAR Comment Goes Here" /end MOD_PAR
/begin MOD_COMMON "Mod Common Comment Here" BYTE_ORDER MSB_LAST ALIGNMENT_BYTE 1 ALIGNMENT_WORD 2 ALIGNMENT_LONG 4 ALIGNMENT_FLOAT32_IEEE 4 ALIGNMENT_FLOAT64_IEEE 8 ALIGNMENT_INT64 8 /end MOD_COMMON
/begin CHARACTERISTIC mymodel_P.DataStoreMemory_InitialValue "" VALUE 0x00410038 Record_FLOAT64_IEEE 0 mymodel_CM_double -1.7E+308 1.7E+308 /end CHARACTERISTIC
/begin CHARACTERISTIC mymodel_P.DiscreteTimeIntegrator1_IC "" VALUE 0x00410048 Record_FLOAT64_IEEE 0 mymodel_CM_double -1.7E+308 1.7E+308 /end CHARACTERISTIC
/begin CHARACTERISTIC mymodel_P.DiscreteTimeIntegrator1_gainval "" VALUE 0x00410040 Record_FLOAT64_IEEE 0 mymodel_CM_double -1.7E+308 1.7E+308 /end CHARACTERISTIC
/begin CHARACTERISTIC mymodel_P.DiscreteTimeIntegrator_IC "" VALUE 0x00410058 Record_FLOAT64_IEEE 0 mymodel_CM_double -1.7E+308 1.7E+308 /end CHARACTERISTIC
/begin CHARACTERISTIC mymodel_P.DiscreteTimeIntegrator_gainval "" VALUE 0x00410050 Record_FLOAT64_IEEE 0 mymodel_CM_double -1.7E+308 1.7E+308 /end CHARACTERISTIC
/begin CHARACTERISTIC mymodel_P.SineWave_Amp "" VALUE 0x00410060 Record_FLOAT64_IEEE 0 mymodel_CM_double -1.7E+308 1.7E+308 /end CHARACTERISTIC
/begin CHARACTERISTIC mymodel_P.SineWave_Bias "" VALUE 0x00410068 Record_FLOAT64_IEEE 0 mymodel_CM_double -1.7E+308 1.7E+308 /end CHARACTERISTIC
/begin CHARACTERISTIC mymodel_P.SineWave_NumSamp "" VALUE 0x00410070 Record_FLOAT64_IEEE 0 mymodel_CM_double -1.7E+308 1.7E+308 /end CHARACTERISTIC
/begin CHARACTERISTIC mymodel_P.SineWave_Offset "" VALUE 0x00410078 Record_FLOAT64_IEEE 0 mymodel_CM_double -1.7E+308 1.7E+308 /end CHARACTERISTIC
/begin CHARACTERISTIC mymodel_P.b "" VALUE 0x00410020 Record_FLOAT64_IEEE 0 mymodel_CM_double -1.7E+308 1.7E+308 /end CHARACTERISTIC
/begin CHARACTERISTIC mymodel_P.k "" VALUE 0x00410028 Record_FLOAT64_IEEE 0 mymodel_CM_double -1.7E+308 1.7E+308 /end CHARACTERISTIC
/begin CHARACTERISTIC mymodel_P.m "" VALUE 0x00410030 Record_FLOAT64_IEEE 0 mymodel_CM_double -1.7E+308 1.7E+308 /end CHARACTERISTIC
/begin MEASUREMENT mymodel_B.a "" FLOAT64_IEEE mymodel_CM_double 0 0 -1.7E+308 1.7E+308 ECU_ADDRESS 0x0041A470 /end MEASUREMENT
/begin MEASUREMENT mymodel_B.v "" FLOAT64_IEEE mymodel_CM_double 0 0 -1.7E+308 1.7E+308 ECU_ADDRESS 0x0041A468 /end MEASUREMENT
/begin MEASUREMENT mymodel_B.x "" FLOAT64_IEEE mymodel_CM_double 0 0 -1.7E+308 1.7E+308 ECU_ADDRESS 0x0041A460 /end MEASUREMENT
/begin MEASUREMENT mymodel_DW.A "" FLOAT64_IEEE mymodel_CM_double 0 0 -1.7E+308 1.7E+308 ECU_ADDRESS 0x0000 /* @ECU_Address@mymodel_DW.A@ */ DISPLAY_IDENTIFIER xddd READ_WRITE /end MEASUREMENT
/begin MEASUREMENT mymodel_DW.DiscreteTimeIntegrator1_DSTATE "" FLOAT64_IEEE mymodel_CM_double 0 0 -1.7E+308 1.7E+308 ECU_ADDRESS 0x0041A440 /end MEASUREMENT
/begin MEASUREMENT mymodel_DW.DiscreteTimeIntegrator_DSTATE "" FLOAT64_IEEE mymodel_CM_double 0 0 -1.7E+308 1.7E+308 ECU_ADDRESS 0x0041A448 /end MEASUREMENT
/begin MEASUREMENT mymodel_DW.counter "" SLONG mymodel_CM_int32 0 0 -2147483648 2147483647 ECU_ADDRESS 0x0041A458 /end MEASUREMENT
/begin MEASUREMENT mymodel_Y.Out1 "" FLOAT64_IEEE mymodel_CM_double 0 0 -1.7E+308 1.7E+308 LAYOUT COLUMN_DIR MATRIX_DIM 3 ECU_ADDRESS 0x0041A480 /end MEASUREMENT
/begin COMPU_METHOD /* Name of CompuMethod */ mymodel_CM_double "Q = V" /* Conversion Type */ IDENTICAL /* Format */ "%15.10" /* Units */ "" /end COMPU_METHOD
/begin COMPU_METHOD /* Name of CompuMethod */ mymodel_CM_int32 "Q = V" /* Conversion Type */ IDENTICAL /* Format */ "%10.0" /* Units */ "" /end COMPU_METHOD
/begin RECORD_LAYOUT Record_FLOAT64_IEEE FNC_VALUES 1 FLOAT64_IEEE COLUMN_DIR DIRECT /end RECORD_LAYOUT
/begin RECORD_LAYOUT Record_SLONG FNC_VALUES 1 SLONG COLUMN_DIR DIRECT /end RECORD_LAYOUT
/begin GROUP mymodel "mymodel" /* Root */ ROOT
 /begin REF_CHARACTERISTIC mymodel_P.DataStoreMemory_InitialValue mymodel_P.DiscreteTimeIntegrator1_IC mymodel_P.DiscreteTimeIntegrator1_gainval mymodel_P.DiscreteTimeIntegrator_IC mymodel_P.DiscreteTimeIntegrator_gainval mymodel_P.SineWave_Amp mymodel_P.SineWave_Bias mymodel_P.SineWave_NumSamp mymodel_P.SineWave_Offset mymodel_P.b mymodel_P.k mymodel_P.m /end REF_CHARACTERISTIC
 /begin REF_MEASUREMENT mymodel_B.a mymodel_B.v mymodel_B.x mymodel_DW.A mymodel_DW.DiscreteTimeIntegrator1_DSTATE mymodel_DW.DiscreteTimeIntegrator_DSTATE mymodel_DW.counter /end REF_MEASUREMENT
/end GROUP
/end MODULE
/end PROJECT
/* (add any file trailer comments here) */
/* EOF mymodel.a2l*/
